## app/boards/arm/mdbt50q_rx/mdbt50q_rx_defconfig
```kconfig
CONFIG_SOC_SERIES_NRF52X=y
CONFIG_SOC_NRF52840_QIAA=y
CONFIG_BOARD_MDBT50Q_RX=y

# Use DeviceTree partition, which is important when using with the Adafruit UF2
# bootloader.
CONFIG_USE_DT_CODE_PARTITION=y

# Enable MPU.
CONFIG_ARM_MPU=y

# Enable hardware stack protection.
CONFIG_HW_STACK_PROTECTION=y

# Enable basic functionality.
CONFIG_ADC=y
CONFIG_GPIO=y

# Use NVS for settings.
CONFIG_MPU_ALLOW_FLASH_WRITE=y
CONFIG_NVS=y
CONFIG_SETTINGS_NVS=y
CONFIG_FLASH=y
CONFIG_FLASH_PAGE_LAYOUT=y
CONFIG_FLASH_MAP=y

# Use maximum Bluetooth transmit power.
CONFIG_BT_CTLR_TX_PWR_PLUS_8=y
```

## app/boards/arm/mdbt50q_rx_dev/Kconfig.defconfig
```kconfig
if BOARD_MDBT50Q_RX

config BOARD
	default "MDBT50Q-RX"

if USB

config USB_NRFX
	default y

config USB_DEVICE_STACK
	default y

endif # USB

config BT_CTLR
	default BT

endif # BOARD_MDBT50Q_RX
```

## app/boards/arm/mdbt50q_rx_dev/mdbt50q_rx_dev_defconfig
```kconfig
CONFIG_SOC_SERIES_NRF52X=y
CONFIG_SOC_NRF52840_QIAA=y
CONFIG_BOARD_MDBT50Q_RX=y

# Use DeviceTree partition, which is important when using with the Adafruit UF2
# bootloader.
CONFIG_USE_DT_CODE_PARTITION=y

# Enable MPU.
CONFIG_ARM_MPU=y

# Enable hardware stack protection.
CONFIG_HW_STACK_PROTECTION=y

# Enable basic functionality.
CONFIG_ADC=y
CONFIG_GPIO=y

# Use NVS for settings.
CONFIG_MPU_ALLOW_FLASH_WRITE=y
CONFIG_NVS=y
CONFIG_SETTINGS_NVS=y
CONFIG_FLASH=y
CONFIG_FLASH_PAGE_LAYOUT=y
CONFIG_FLASH_MAP=y

################################################################################

CONFIG_DEBUG=y
CONFIG_LOG=y
CONFIG_LOG_BACKEND_SHOW_COLOR=n

# Use SEGGER J-Link for debugging.
CONFIG_USE_SEGGER_RTT=y
CONFIG_CONSOLE=y
CONFIG_RTT_CONSOLE=y
CONFIG_SEGGER_RTT_BUFFER_SIZE_UP=8192

# Omit the boot banner as that causes the RTT log to be recognized as a file
# with LF ending whereas all of the log messages end with CRLF. TODO TODO TODO
CONFIG_BOOT_BANNER=n

# TODO TODO TODO
CONFIG_LOG_STRDUP_BUF_COUNT=16
CONFIG_LOG_BUFFER_SIZE=8192

# TODO TODO TODO figure out best value. under 1000?
CONFIG_LOG_PROCESS_THREAD_SLEEP_MS=100

# TODO TODO TODO
CONFIG_ZMK_SPLIT_BLE_CENTRAL_PERIPHERALS=2
```

## app/boards/arm/slicemk_ergodox/Kconfig.board
```kconfig
config BOARD_SLICEMK_ERGODOX
	bool "SliceMK ErgoDox"
	depends on SOC_NRF52840_QIAA
```

## app/boards/arm/slicemk_ergodox/Kconfig.defconfig
```kconfig
if BOARD_SLICEMK_ERGODOX

config BOARD
	default "SliceMK ErgoDox"

if USB

config USB_NRFX
	default y

config USB_DEVICE_STACK
	default y

endif # USB

config BT_CTLR
	default BT

endif # BOARD_SLICEMK_ERGODOX
```

## app/boards/shields/slicemk_ergodox/Kconfig.defconfig
```kconfig
config ZMK_BLE
	default y

config ZMK_USB
	default y

if SHIELD_SLICEMK_ERGODOX_DONGLE

config ZMK_KEYBOARD_NAME
	default "SliceMK ErgoDox"

config ZMK_SPLIT_BLE_ROLE_CENTRAL
	default y

endif

if !SHIELD_SLICEMK_ERGODOX_DONGLE

config ZMK_BATTERY_VOLTAGE_DIVIDER
	default y

endif

if SHIELD_SLICEMK_ERGODOX_LEFT

config ZMK_KEYBOARD_NAME
	default "ErgoDox Left"

endif

if SHIELD_SLICEMK_ERGODOX_RIGHT

config ZMK_KEYBOARD_NAME
	default "ErgoDox Right"

endif

if SHIELD_SLICEMK_ERGODOX_DONGLE || SHIELD_SLICEMK_ERGODOX_LEFT || SHIELD_SLICEMK_ERGODOX_RIGHT

config ZMK_SPLIT
	default y

endif
```

## app/boards/shields/slicemk_ergodox/Kconfig.shield
```kconfig
config SHIELD_SLICEMK_ERGODOX_DONGLE
	def_bool $(shields_list_contains,slicemk_ergodox_dongle)

config SHIELD_SLICEMK_ERGODOX_LEFT
	def_bool $(shields_list_contains,slicemk_ergodox_left)

config SHIELD_SLICEMK_ERGODOX_RIGHT
	def_bool $(shields_list_contains,slicemk_ergodox_right)
```
