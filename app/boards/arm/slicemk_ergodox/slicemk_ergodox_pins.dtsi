/*
 * Copyright (c) 2020 Pete Johanson
 *
 * SPDX-License-Identifier: MIT
 */

/ {
	ergodox_a: connector_a {
		compatible = "ergodox-a";
		#gpio-cells = <2>;
		gpio-map-mask = <0xffffffff 0xffffffc0>;
		gpio-map-pass-thru = <0 0x3f>;
		gpio-map
			= <0  0 &gpio0 24 0>
			, <1  0 &gpio0 22 0>
			, <2  0 &gpio0 20 0>
			, <3  0 &gpio0 19 0>
			, <4  0 &gpio0 15 0>
			, <5  0 &gpio0 13 0>
			, <6  0 &gpio1  1 0>
			, <7  0 &gpio1  7 0>
			, <8  0 &gpio1  6 0>
			, <9  0 &gpio1 12 0>
			, <10 0 &gpio1 14 0>
			, <11 0 &gpio1 15 0>
			, <12 0 &gpio1  8 0>
			;
	};
};
