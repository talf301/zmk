/dts-v1/;
#include "slicemk_ergodox_202205_green_common.dts"

/ {
	ext-power {
		compatible = "zmk,ext-power-generic";
		label = "EXT_POWER";
		control-gpios = <&gpio0 27 GPIO_ACTIVE_HIGH>;
		init-delay-ms = <50>;
	};

	ergodox_a: ergodox_a {
		compatible = "ergodox-a";
		#gpio-cells = <2>;
		gpio-map-mask = <0xffffffff 0xffffffc0>;
		gpio-map-pass-thru = <0 0x3f>;
		gpio-map
			= <0 0 &gpio0 30 0>
			, <1 0 &gpio0 9 0>
			, <2 0 &gpio0 24 0>
			, <3 0 &gpio1 1 0>
			, <4 0 &gpio1 6 0>
			, <5 0 &gpio0 21 0>
			, <6 0 &gpio0 15 0>
			, <7 0 &gpio0 2 0>
			, <8 0 &gpio0 26 0>
			, <9 0 &gpio0 6 0>
			, <10 0 &gpio0 8 0>
			, <11 0 &gpio1 9 0>
			, <12 0 &gpio0 12 0>
			;
	};
};

&spi0 {
	// Define pin for LED data.
	mosi-pin = <20>;

	// Zephyr requires SCK and MISO to be defined but they are not used so pick
	// two random unused pins.
	sck-pin = <19>;
	miso-pin = <23>;
};
